// Generated by Gemini
#include <Wire.h>
#include <SPI.h>
#include <Adafruit_GFX.h>
#include <Adafruit_ST7789.h>

// ==========================================
// PIN DEFINITIONS
// ==========================================

// --- TFT Screen (1.3" 240x240 ST7789) ---
// Note: CS pin is assumed grounded/absent on this module
#define TFT_SCL 35 // SPI SCK
#define TFT_SDA 36 // SPI MOSI
#define TFT_RES 37 // Reset
#define TFT_DC  38 // Data/Command
#define TFT_BLK 39 // Backlight

// --- I2C & Multiplexer ---
#define I2C_SDA 47
#define I2C_SCL 48
#define TCA_ADDR 0x70
#define BQ25890_ADDR 0x6A // Default I2C address for BQ25890

// --- Fan & Buzzer (PWM) ---
#define FAN_PIN 40
#define BUZZER_PIN 17

// --- Buttons ---
#define BTN_LEFT 8
#define BTN_RIGHT 18

// --- Channel Arrays (1 to 6) ---
// ESP32-S3 Defaults: RXD0 is GPIO44, TXD0 is GPIO43
const uint8_t DISCHARGE_PINS[6] = {41, 42, 44, 13, 14, 21};
const uint8_t CE_PINS[6]        = {43, 2, 1, 12, 11, 10};

// TCA9548A Ports mapped to Channels 1-6: S6, S5, S4, S1, S2, S3
const uint8_t TCA_PORTS[6]      = {6, 5, 4, 1, 2, 3};

// Initialize TFT Display (-1 for CS since it is unused/grounded)
Adafruit_ST7789 tft = Adafruit_ST7789(-1, TFT_DC, TFT_SDA, TFT_SCL, TFT_RES);

// ==========================================
// HELPER FUNCTIONS
// ==========================================

// Switch the TCA9548A multiplexer to a specific port
void tcaSelectPort(uint8_t port) {
  if (port > 7) return;
  Wire.beginTransmission(TCA_ADDR);
  Wire.write(1 << port); 
  Wire.endTransmission();
}

// Example function: Read the system status register from BQ25890
uint8_t readBQ25890Status(uint8_t channelIndex) {
  // 1. Switch I2C Mux to the correct port for this channel
  tcaSelectPort(TCA_PORTS[channelIndex]);
  
  // 2. Request Register 0x0B (System Status Register)
  Wire.beginTransmission(BQ25890_ADDR);
  Wire.write(0x0B); 
  Wire.endTransmission(false); // Repeated start
  
  Wire.requestFrom(BQ25890_ADDR, 1);
  if (Wire.available()) {
    return Wire.read();
  }
  return 0xFF; // Return error state if nothing read
}

// ==========================================
// MAIN SETUP
// ==========================================

void setup() {
  Serial.begin(115200);
  delay(1000); // Give Serial time to initialize
  
  Serial.println("Starting Charge Controller...");

  // 1. Initialize I2C Bus (with external pullups on the multiplexer)
  Wire.begin(I2C_SDA, I2C_SCL);
  Wire.setClock(400000); // Fast I2C

  // 2. Initialize Buttons (Internal Pullups)
  pinMode(BTN_LEFT, INPUT_PULLUP);
  pinMode(BTN_RIGHT, INPUT_PULLUP);

  // 3. Initialize Fan and Buzzer
  pinMode(FAN_PIN, OUTPUT);
  pinMode(BUZZER_PIN, OUTPUT);
  analogWrite(FAN_PIN, 0);    // Turn off fan initially
  analogWrite(BUZZER_PIN, 0); // Turn off buzzer initially

  // 4. Initialize Channel Pins
  for (int i = 0; i < 6; i++) {
    // Dischargers
    pinMode(DISCHARGE_PINS[i], OUTPUT);
    analogWrite(DISCHARGE_PINS[i], 0); // 0% duty cycle (Off)

    // BQ25890 Charge Enable (CE)
    // Note: BQ25890 CE pin is usually Active LOW. High = Disabled, Low = Enabled.
    pinMode(CE_PINS[i], OUTPUT);
    digitalWrite(CE_PINS[i], HIGH); // Default to disabled for safety
  }

  // 5. Initialize TFT Display
  pinMode(TFT_BLK, OUTPUT);
  digitalWrite(TFT_BLK, HIGH); // Turn on backlight
  
  tft.init(240, 240); // Initialize standard 240x240 TFT
  tft.setRotation(2); // Adjust 0-3 depending on your screen orientation
  tft.fillScreen(ST77XX_BLACK);
  
  // Draw Initial UI
  tft.setCursor(10, 10);
  tft.setTextColor(ST77XX_WHITE);
  tft.setTextSize(2);
  tft.println("Controller Init");
  tft.println("Status: OK");
}

// ==========================================
// MAIN LOOP
// ==========================================

void loop() {
  // 1. Handle Button Inputs
  if (digitalRead(BTN_LEFT) == LOW) {
    Serial.println("Left Button Pressed");
    // Add debounce & logic here
    delay(200); 
  }
  
  if (digitalRead(BTN_RIGHT) == LOW) {
    Serial.println("Right Button Pressed");
    // Add debounce & logic here
    delay(200); 
  }

  // 2. Scan BQ25890 Statuses via Multiplexer
  // (We'll print them to Serial, but you can draw them to the TFT later)
  for (int i = 0; i < 6; i++) {
    uint8_t status = readBQ25890Status(i);
    
    // Check if communication failed
    if(status == 0xFF) {
      Serial.printf("Ch %d (Mux Port %d): BQ25890 Not Found\n", i+1, TCA_PORTS[i]);
    } else {
      // VBUS Status is bits 7:6 in reg 0x0B
      uint8_t vbusStat = (status & 0b11000000) >> 6;
      Serial.printf("Ch %d (Mux Port %d): Status Reg 0x%02X | VBUS: %d\n", i+1, TCA_PORTS[i], status, vbusStat);
    }
  }
  
  Serial.println("-------------------------");
  
  // 3. Example: Update Display dynamically
  tft.fillRect(10, 50, 220, 40, ST77XX_BLACK); // Clear previous text area
  tft.setCursor(10, 50);
  tft.setTextColor(ST77XX_GREEN);
  tft.setTextSize(2);
  tft.printf("Uptime: %lu s", millis() / 1000);

  // 4. Example: Fan Control (Sweep 0 to 255)
  // analogWrite(FAN_PIN, 128); // 50% Speed

  delay(1000); // Wait 1 second before next cycle
}